## drivers/infiniband/hw/ntrdma/Kconfig
```kconfig
config NTRDMA
	tristate "Non-transparent RDMA support"
	depends on NTC && NETDEVICES && INET
	---help---
	  The NTRDMA driver is an RDMA driver for a Non-Transparent Channel,
	  such as a PCI-express Non-Transparent Bridge.  The NTRDMA driver
	  supports the basic functionality of the Infiniband verbs programming
	  interface, and an Ethernet device.

if NTRDMA

config NTRDMA_VBELL_USE_SEQ
	bool "Use virtual doorbell sequence numbers"
	default y
	---help---
	  Use sequence numbers instead of flags to indicate virtual doorbell status.

	  If unsure, select Y.

config NTRDMA_RETRY_RECV
	bool "Retry a failed send if missing a recv"
	default y
	---help---
	  Instead of failing a queue pair processing a send, if missing a
	  receive, retry the operation.  A recv may be soon to be posted.  This
	  is a workaround for applications that do not properly implement flow
	  control for posting work requests.

	  If unsure, select Y.

endif #ntrdma
```

## drivers/ntc/Kconfig
```kconfig
menuconfig NTC
	tristate "Non-Transparent Channel support"
	help
	  The Non-Transparent Channel is an abstraction of the basic
	  functionality of a Non-Transparent Bridge (NTB) and DMA engine.  It
	  provides functions to map memory so that it can be accessed by the
	  peer, and functions to operate on the peer memory.  An abstraction is
	  used, because the peer memory may be mapped by some mechanism other
	  than DMA, and be accessed via something other than NTB.

	  If unsure, say N.

if NTC

config NTC_NTB
	tristate "Non-Transparent Bridge NTC"
	help
	  This is an NTC back end using a PCI-express Non-Transparent Bridge,
	  and a general purpose DMA engine on the same PCI-express root port.

	  FIXME: this driver is not implemented!

	  If unsure, say N.

config NTC_NTB_MSI
	tristate "Non-Transparent Bridge NTC with MSI workaround"
	help
	  This is an NTC back end using a PCI-express Non-Transparent Bridge,
	  and a general purpose DMA engine on the same PCI-express root port.

	  This driver avoids using any NTB functions after link initialization.
	  The NTB scratchpad is used during initialization.  The NTB doorbell
	  is never used.  Instead, message signaled interrupt (MSI) data is
	  written directly to the peer interrupt controller.

	  If unsure, say N.

config NTC_TCP
	tristate "TCP kernel socket NTC"
	help
	  This is an NTC back end using a kernel TCP socket, and a simple
	  protocol to read and write kernel-virtual mapped memory via socket
	  operations.

	  If unsure, say N.

endif # NTC
```
